/**********************************************************************************
BSD 3-Clause License

Copyright (c) 2021, Orso Eric
All rights reserved.

Redistribution and use in source and binary forms, with or without
modification, are permitted provided that the following conditions are met:

1. Redistributions of source code must retain the above copyright notice, this
   list of conditions and the following disclaimer.

2. Redistributions in binary form must reproduce the above copyright notice,
   this list of conditions and the following disclaimer in the documentation
   and/or other materials provided with the distribution.

3. Neither the name of the copyright holder nor the names of its
   contributors may be used to endorse or promote products derived from
   this software without specific prior written permission.

THIS SOFTWARE IS PROVIDED BY THE COPYRIGHT HOLDERS AND CONTRIBUTORS "AS IS"
AND ANY EXPRESS OR IMPLIED WARRANTIES, INCLUDING, BUT NOT LIMITED TO, THE
IMPLIED WARRANTIES OF MERCHANTABILITY AND FITNESS FOR A PARTICULAR PURPOSE ARE
DISCLAIMED. IN NO EVENT SHALL THE COPYRIGHT HOLDER OR CONTRIBUTORS BE LIABLE
FOR ANY DIRECT, INDIRECT, INCIDENTAL, SPECIAL, EXEMPLARY, OR CONSEQUENTIAL
DAMAGES (INCLUDING, BUT NOT LIMITED TO, PROCUREMENT OF SUBSTITUTE GOODS OR
SERVICES; LOSS OF USE, DATA, OR PROFITS; OR BUSINESS INTERRUPTION) HOWEVER
CAUSED AND ON ANY THEORY OF LIABILITY, WHETHER IN CONTRACT, STRICT LIABILITY,
OR TORT (INCLUDING NEGLIGENCE OR OTHERWISE) ARISING IN ANY WAY OUT OF THE USE
OF THIS SOFTWARE, EVEN IF ADVISED OF THE POSSIBILITY OF SUCH DAMAGE.
**********************************************************************************/

/**********************************************************************************
**  ENVIROMENT VARIABILE
**********************************************************************************/

#ifndef CLASS_ERROR_HANDLER_HPP_
    #define CLASS_ERROR_HANDLER_HPP_

/**********************************************************************************
**  GLOBAL INCLUDES
**********************************************************************************/

/**********************************************************************************
**  DEFINES
**********************************************************************************/

/**********************************************************************************
**  MACROS
**********************************************************************************/

/**********************************************************************************
**  NAMESPACE
**********************************************************************************/

//! @namespace custom namespace
namespace User
{

/**********************************************************************************
**  TYPEDEFS
**********************************************************************************/

/**********************************************************************************
**  PROTOTYPE: STRUCTURES
**********************************************************************************/

/**********************************************************************************
**  PROTOTYPE: GLOBAL VARIABILES
**********************************************************************************/

/**********************************************************************************
**  PROTOTYPE: CLASS
**********************************************************************************/

/************************************************************************************/
//! @class      Error_handler
/************************************************************************************/
//!	@author     Orso Eric
//! @version    2021-03-21
//! @brief      Handles errors and warnings
//! @copyright  BSD 3-Clause License Copyright (c) 2021, Orso Eric
//! @details
//! \n	Error and warning reporting, getting and reset
//! \n	I always need a way to store basic execution flow warning and errors
//! \n	The Error handler class allows me to do so with a debugged code
//! \n	This class can be either instanced as a variable inside a parent class or inherited as public class
//! \n	class Class_under_test
//! \n	{
//! \n		private:
//! \n			User::Error_handler my_error_handler
//! \n	}
//! \n	class Class_under_test : public User::Error_handler
//! \n	{
//! \n
//! \n	}
//! \n
//! \n		Specifications:
//! \n	>Warning/Error: handle flag and description of error and warning. Methods to clear and signal them
//! \n	>FSM: well defined behaviour of report/reset/get methods on error/warning flags
//! \n	>Fast: as little overhead as possible when handling warnings and errors
//! \n	>No allocation: just store a pointer to c string.
//! \n		Meant to work with user readable errors in constant string form "ERR: bad stuffs here"
//! \n		This library can't and shouldn't handle runtime string. If needed, propagate them another way
//! \n
//! \n		History
//! \n		2021-03-21
//! \n	Initial Release
//! \n		2021-03-27
//! \n	Try std::string. Handle runtime error string e.g. "ERR: value is 17 instead of 19" but brings in allocation and additional work
//! \n		2021-03-28
//! \n	Rollback to original mechanism of just storing const char *& inside the class. Fast and cheap.
/************************************************************************************/

class Error_handler
{
    //Visible to all
    public:
        /*********************************************************************************************************************************************************
        **********************************************************************************************************************************************************
        **  PUBLIC ENUMS
        **********************************************************************************************************************************************************
        *********************************************************************************************************************************************************/

        //! @brief Configurations of the class
        typedef enum _Config
        {
        	//Set behaviour of the get_error and get_warning public getters
        	DEFAULT_CONFIG_GET_RESET = false,
        } Config;

        /*********************************************************************************************************************************************************
        **********************************************************************************************************************************************************
        **  PUBLIC TYPEDEFS
        **********************************************************************************************************************************************************
        *********************************************************************************************************************************************************/

        /*********************************************************************************************************************************************************
        **********************************************************************************************************************************************************
        **  CONSTRUCTORS
        **********************************************************************************************************************************************************
        *********************************************************************************************************************************************************/

        //Empty Constructor
        Error_handler( void );

        /*********************************************************************************************************************************************************
        **********************************************************************************************************************************************************
        **  DESTRUCTORS
        **********************************************************************************************************************************************************
        *********************************************************************************************************************************************************/

        //Empty destructor
        ~Error_handler( void );

        /*********************************************************************************************************************************************************
        **********************************************************************************************************************************************************
        **  PUBLIC OPERATORS
        **********************************************************************************************************************************************************
        *********************************************************************************************************************************************************/

        /*********************************************************************************************************************************************************
        **********************************************************************************************************************************************************
        **  PUBLIC SETTERS
        **********************************************************************************************************************************************************
        *********************************************************************************************************************************************************/

        //! @brief Configure class behaviour.
        inline bool set_config_reset( bool i_u1_config_get_reset )
        {
        	//Calling a get_warning or get_error will reset the warning or error
			this->gu1_config_get_reset = i_u1_config_get_reset;
			return false; //OK
        }
		//Report a warning or an error
        bool report_warning( const char *i_pu8_warning_description );
        bool report_error( const char *i_pu8_error_description );
        //! @brief Reset warning flag and description
		inline bool reset_warning( void )
		{
			//Propagate warning initialization
			return this->init_warning();
		}
		//! @brief Reset warning flag and description
		inline bool reset_error( void )
		{
			//Propagate warning initialization
			return this->init_error();
		}

        /*********************************************************************************************************************************************************
        **********************************************************************************************************************************************************
        **  PUBLIC GETTERS
        **********************************************************************************************************************************************************
        *********************************************************************************************************************************************************/

        //Get current warning state of the library. Automatically reset error
        const char * &get_warning( void );
        bool get_warning( const char * &o_u8p_warning_description );
        //Get current error state of the library. Automatically reset error
        const char * &get_error( void );
        bool get_error( const char * &ou8p_error_description );

        /*********************************************************************************************************************************************************
        **********************************************************************************************************************************************************
        **  PUBLIC TESTERS
        **********************************************************************************************************************************************************
        *********************************************************************************************************************************************************/

        //! @brief test warning state. true = warning | false = OK. With a warning the application can continue running.
        inline bool is_warning( void )
        {
        	return this->gu1_is_warning;
        }
        //! @brief test error state. true = error | false = OK. With an error, the application is forbidden to continue execution flow
        inline bool is_error( void )
        {
        	return this->gu1_is_error;
        }

        /*********************************************************************************************************************************************************
        **********************************************************************************************************************************************************
        **  PUBLIC METHODS
        **********************************************************************************************************************************************************
        *********************************************************************************************************************************************************/

        /*********************************************************************************************************************************************************
        **********************************************************************************************************************************************************
        **  PUBLIC STATIC METHODS
        **********************************************************************************************************************************************************
        *********************************************************************************************************************************************************/

        /*********************************************************************************************************************************************************
        **********************************************************************************************************************************************************
        **  PUBLIC VARS
        **********************************************************************************************************************************************************
        *********************************************************************************************************************************************************/

    //Visible to derived classes
    protected:
        /*********************************************************************************************************************************************************
        **********************************************************************************************************************************************************
        **  PROTECTED METHODS
        **********************************************************************************************************************************************************
        *********************************************************************************************************************************************************/

        /*********************************************************************************************************************************************************
        **********************************************************************************************************************************************************
        **  PROTECTED VARS
        **********************************************************************************************************************************************************
        *********************************************************************************************************************************************************/

    //Visible only inside the class
    private:
        /*********************************************************************************************************************************************************
        **********************************************************************************************************************************************************
        **	PRIVATE ENUM
        **********************************************************************************************************************************************************
        *********************************************************************************************************************************************************/

        /*********************************************************************************************************************************************************
        **********************************************************************************************************************************************************
        **	PRIVATE TYPEDEFS
        **********************************************************************************************************************************************************
        *********************************************************************************************************************************************************/

        /*********************************************************************************************************************************************************
        **********************************************************************************************************************************************************
        **	PRIVATE INIT
        **********************************************************************************************************************************************************
        *********************************************************************************************************************************************************/

        //Initialize class vars
        bool init_class_vars( void );
		bool init_warning();
		bool init_error();

        /*********************************************************************************************************************************************************
        **********************************************************************************************************************************************************
        **	PRIVATE METHODS
        **********************************************************************************************************************************************************
        *********************************************************************************************************************************************************/

        /*********************************************************************************************************************************************************
        **********************************************************************************************************************************************************
        **	PRIVATE VARS
        **********************************************************************************************************************************************************
        *********************************************************************************************************************************************************/

        //Default OK
        const char *c_pu8_default_ok = "OK";
        //Class configuration
		bool gu1_config_get_reset;
        //Error and Warning flag
        bool gu1_is_error;
        bool gu1_is_warning;
        //Error and warning codes
        const char *gpu8_error_description;
        const char *gpu8_warning_description;
};	//End Class: Error_handler

/*********************************************************************************************************************************************************
**********************************************************************************************************************************************************
**	CONSTRUCTORS
**********************************************************************************************************************************************************
*********************************************************************************************************************************************************/

/***************************************************************************/
//! @brief Constructor
//! \n Error_handler | void
/***************************************************************************/
// @param
//! @return no return
//! @details
//! \n Empty constructor
/***************************************************************************/

Error_handler::Error_handler( void )
{
    ///--------------------------------------------------------------------------
    ///	BODY
    ///--------------------------------------------------------------------------

    //Initialize class vars
    this -> init_class_vars();

    ///--------------------------------------------------------------------------
    ///	RETURN
    ///--------------------------------------------------------------------------
    return;
}   //end constructor: Error_handler | void

/*********************************************************************************************************************************************************
**********************************************************************************************************************************************************
**	DESTRUCTORS
**********************************************************************************************************************************************************
*********************************************************************************************************************************************************/

/***************************************************************************/
//!	@brief Destructor
//! \n Error_handler | void
/***************************************************************************/
// @param
//! @return no return
//! @details
//! \n Empty destructor
/***************************************************************************/

Error_handler::~Error_handler( void )
{
	///--------------------------------------------------------------------------
    ///	INIT
    ///--------------------------------------------------------------------------

    ///--------------------------------------------------------------------------
    ///	BODY
    ///--------------------------------------------------------------------------

    ///--------------------------------------------------------------------------
    ///	RETURN
    ///--------------------------------------------------------------------------
    return;         //OK
}   //end destructor: Error_handler | void

/*********************************************************************************************************************************************************
**********************************************************************************************************************************************************
**	PUBLIC OPERATORS
**********************************************************************************************************************************************************
*********************************************************************************************************************************************************/

/*********************************************************************************************************************************************************
**********************************************************************************************************************************************************
**	PUBLIC SETTERS
**********************************************************************************************************************************************************
*********************************************************************************************************************************************************/

/***************************************************************************/
//! @brief Private method
//! \n report_warning | const char *
/***************************************************************************/
//! @param i_pu8_warning_description | const char *
//! @return bool | false = OK | true = FAIL |
//! @details
//! \n Report a warning
/***************************************************************************/

bool Error_handler::report_warning( const char *i_pu8_warning_description )
{
	///--------------------------------------------------------------------------
    ///	INIT
    ///--------------------------------------------------------------------------

    //If: warning is already active
    if (this->gu1_is_warning == true)
	{
		//Warning already aserted. Only save the oldest one
		return true;
	}

    ///--------------------------------------------------------------------------
    ///	BODY
    ///--------------------------------------------------------------------------

    //Report warning
    this->gu1_is_warning = true;
    this->gpu8_warning_description = i_pu8_warning_description;

    ///--------------------------------------------------------------------------
    ///	RETURN
    ///--------------------------------------------------------------------------
    return false;	//OK
}   //end private method: report_warning | const char *

/***************************************************************************/
//! @brief Private method
//! \n report_error | const char *
/***************************************************************************/
//! @param i_pu8_error_description | const char *
//! @return bool | false = OK | true = FAIL |
//! @details
//! \n Report a error
/***************************************************************************/

bool Error_handler::report_error( const char *i_pu8_error_description )
{
	///--------------------------------------------------------------------------
    ///	INIT
    ///--------------------------------------------------------------------------

    //If: error is already active
    if (this->gu1_is_error == true)
	{
		//error already aserted. Only save the oldest one
		return true;
	}

    ///--------------------------------------------------------------------------
    ///	BODY
    ///--------------------------------------------------------------------------

    //Report error
    this->gu1_is_error = true;
    this->gpu8_error_description = i_pu8_error_description;

    ///--------------------------------------------------------------------------
    ///	RETURN
    ///--------------------------------------------------------------------------
    return false;	//OK
}   //end private method: report_error | const char *

/*********************************************************************************************************************************************************
**********************************************************************************************************************************************************
**	PUBLIC GETTERS
**********************************************************************************************************************************************************
*********************************************************************************************************************************************************/

/***************************************************************************/
//! @brief Public Getter
//! \n get_warning | void
/***************************************************************************/
//! @return const char* & | reference to c string holding the warning
/***************************************************************************/

const char* &Error_handler::get_warning( void )
{
    ///--------------------------------------------------------------------------
    ///	BODY
    ///--------------------------------------------------------------------------

	//If warning active and getter is meant to reset flag
    if (this->gu1_is_warning == true)
	{
		//Reset warning flag
		this->init_warning();
	}

    ///--------------------------------------------------------------------------
    ///	RETURN
    ///--------------------------------------------------------------------------
    return this->gpu8_warning_description;	//Propagate warning
}   //end private method: get_warning | const char* &

/***************************************************************************/
//! @brief Public Getter
//! \n get_warning | const char* &
/***************************************************************************/
//! @param o_u8p_warning_description | const char* & | reference to cstring holding the class warning description
//! @return bool | false = OK | true = Warning |
//! @details
//! \n Get current warning state of the library. Automatically reset error
/***************************************************************************/

bool Error_handler::get_warning( const char* &o_u8p_warning_description )
{
	///--------------------------------------------------------------------------
    ///	INIT
    ///--------------------------------------------------------------------------

    //Remember warning before it's cleared
    bool _u1_ret = this->gu1_is_warning;

    ///--------------------------------------------------------------------------
    ///	BODY
    ///--------------------------------------------------------------------------

	//If warning active and getter is meant to reset flag
    if (_u1_ret == true)
	{
		//Reset warning flag
		this->init_warning();
	}

	//Return description to caller
    o_u8p_warning_description = this->get_warning();

    ///--------------------------------------------------------------------------
    ///	RETURN
    ///--------------------------------------------------------------------------
    return _u1_ret;	//Propagate warning
}   //end private method: get_warning | const char* &

/***************************************************************************/
//! @brief Public Getter
//! \n get_error | void
/***************************************************************************/
//! @return const char* & | reference to c string holding the error
/***************************************************************************/

const char* &Error_handler::get_error( void )
{
    ///--------------------------------------------------------------------------
    ///	BODY
    ///--------------------------------------------------------------------------

	//If error active and getter is meant to reset flag
    if ((this -> gu1_config_get_reset == true) && (this->gu1_is_error == true))
	{
		//Reset error flag
		this->init_error();
	}

    ///--------------------------------------------------------------------------
    ///	RETURN
    ///--------------------------------------------------------------------------
    return this->gpu8_error_description;	//Propagate error
}   //end private method: get_error | const char* &

/***************************************************************************/
//! @brief Public Getter
//! \n get_error | const char* &
/***************************************************************************/
//! @param ou8p_error_description | const char* & | reference to cstring holding the class error description
//! @return bool | false = OK | true = Warning |
//! @details
//! \n Get current error state of the library. Automatically reset error if configured to do so
/***************************************************************************/

bool Error_handler::get_error( const char* &ou8p_error_description )
{
	///--------------------------------------------------------------------------
    ///	INIT
    ///--------------------------------------------------------------------------

    //Remember error state for return
    bool u1_is_error = this->gu1_is_error;

    ///--------------------------------------------------------------------------
    ///	BODY
    ///--------------------------------------------------------------------------

    //Return err
    ou8p_error_description = this->gpu8_error_description;
	//If error active and getter is meant to reset flag
    if ((this -> gu1_config_get_reset == true) && (u1_is_error == true))
	{
		//Reset error
		this-> init_error();
	}

    ///--------------------------------------------------------------------------
    ///	RETURN
    ///--------------------------------------------------------------------------
    return u1_is_error;	//Propagate error
}   //end private method: get_error | const char* &

/*********************************************************************************************************************************************************
**********************************************************************************************************************************************************
**	PRIVATE INIT
**********************************************************************************************************************************************************
*********************************************************************************************************************************************************/

/***************************************************************************/
//! @brief Private Method
//! \n init_class_vars | void
/***************************************************************************/
//! @return bool | false = OK | true = Fail |
//! @details
//! \n Initialize class vars
/***************************************************************************/

bool Error_handler::init_class_vars( void )
{
    ///--------------------------------------------------------------------------
    ///	INIT
    ///--------------------------------------------------------------------------

    //Initialize class configuration
    this->gu1_config_get_reset = Config::DEFAULT_CONFIG_GET_RESET;
	//Reset warning
    this->init_warning();
    //Reset errors
    this->init_error();

    ///--------------------------------------------------------------------------
    ///	RETURN
    ///--------------------------------------------------------------------------
    return false;   //OK
}   //end method: init_class_vars | void

/***************************************************************************/
//! @brief Private Method
//! \n init_warning | void
/***************************************************************************/
//! @return bool | false = OK | true = Fail |
//! @details
//! \n Initialize warning
/***************************************************************************/

bool Error_handler::init_warning( void )
{
    ///--------------------------------------------------------------------------
    ///	BODY
    ///--------------------------------------------------------------------------

    //Reset warning
    this->gu1_is_warning = false;
    this->gpu8_warning_description = this->c_pu8_default_ok;

    ///--------------------------------------------------------------------------
    ///	RETURN
    ///--------------------------------------------------------------------------
    return false;   //OK
}   //end method: init_warning | void

/***************************************************************************/
//! @brief Private Method
//! \n init_error | void
/***************************************************************************/
//! @return bool | false = OK | true = Fail |
//! @details
//! \n Initialize error
/***************************************************************************/

bool Error_handler::init_error( void )
{
    ///--------------------------------------------------------------------------
    ///	BODY
    ///--------------------------------------------------------------------------

    //Reset warning
    this->gu1_is_error = false;
    this->gpu8_error_description = this->c_pu8_default_ok;

    ///--------------------------------------------------------------------------
    ///	RETURN
    ///--------------------------------------------------------------------------
    return false;   //OK
}   //end method: init_error | void

/*********************************************************************************************************************************************************
**********************************************************************************************************************************************************
**	PRIVATE METHODS
**********************************************************************************************************************************************************
*********************************************************************************************************************************************************/

/**********************************************************************************
**	NAMESPACE
**********************************************************************************/

} //End Namespace: User

#else
    #warning "Multiple inclusion of hader file CLASS_ERROR_HANDLER_HPP_"
#endif
